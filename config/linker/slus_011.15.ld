SECTIONS
{
    HIDDEN(__romPos = 0);
    _gp = 0x8005E274;
    header_ROM_START = __romPos;
    header_VRAM = ADDR(.header);
    .header : AT(header_ROM_START) SUBALIGN(2)
    {
        FILL(0x00000000);
        header_DATA_START = .;
        build/asm/header.o(.data);
        header_DATA_END = .;
        header_DATA_SIZE = ABSOLUTE(header_DATA_END - header_DATA_START);
    }
    __romPos += SIZEOF(.header);
    header_ROM_END = __romPos;
    header_VRAM_END = .;

    main_ROM_START = __romPos;
    main_VRAM = ADDR(.main);
    .main 0x80010000 : AT(main_ROM_START) SUBALIGN(2)
    {
        FILL(0x00000000);
        main_RODATA_START = .;
        build/asm/data/800.rodata.o(.rodata);
        build/src/boot.o(.rodata);
        build/src/system.o(.rodata);
        build/asm/data/878.rodata.o(.rodata);
        build/src/text.o(.rodata);
        build/asm/data/A1C.rodata.o(.rodata);
        build/src/ui.o(.rodata);
        build/asm/data/BB0.rodata.o(.rodata);
        build/src/crt0.o(.rodata);
        build/asm/stup0.o(.rodata);
        build/src/display.o(.rodata);
        build/src/archive.o(.rodata);
        build/src/flags.o(.rodata);
        build/src/state_core.o(.rodata);
        build/src/gameplay.o(.rodata);
        build/asm/psyq/adddf3.o(.rodata);
        build/asm/gap_15664.o(.rodata);
        build/asm/psyq/dbshift.o(.rodata);
        build/asm/psyq/fixdfsi.o(.rodata);
        build/asm/psyq/fltsidf.o(.rodata);
        build/asm/psyq/dbshiftu.o(.rodata);
        build/asm/psyq/ltdf2.o(.rodata);
        build/asm/gap_15B94.o(.rodata);
        build/asm/psyq/muldf3.o(.rodata);
        build/asm/psyq/ferr.o(.rodata);
        build/asm/psyq/sin00.o(.rodata);
        build/asm/psyq/divdf3.o(.rodata);
        build/asm/psyq/gedf2.o(.rodata);
        build/asm/gap_167E4.o(.rodata);
        build/asm/psyq/subdf3.o(.rodata);
        build/asm/psyq/sin01.o(.rodata);
        build/asm/psyq/s_gks.o(.rodata);
        build/asm/psyq/spu.o(.rodata);
        build/asm/gap_17544.o(.rodata);
        build/asm/psyq/sr_gaks.o(.rodata);
        build/asm/psyq/s_sca.o(.rodata);
        build/asm/psyq/ssclose.o(.rodata);
        build/asm/psyq/ssend.o(.rodata);
        build/asm/gap_17E34.o(.rodata);
        build/asm/psyq/s_crwa.o(.rodata);
        build/asm/psyq/s_m_util.o(.rodata);
        build/asm/psyq/ssopenq.o(.rodata);
        build/asm/gap_18474.o(.rodata);
        build/asm/psyq/cc_6.o(.rodata);
        build/asm/gap_18874.o(.rodata);
        build/asm/psyq/cc_64.o(.rodata);
        build/asm/gap_18BB4.o(.rodata);
        build/asm/psyq/cc_99.o(.rodata);
        build/asm/gap_18E84.o(.rodata);
        build/asm/psyq/de_1.o(.rodata);
        build/asm/gap_19174.o(.rodata);
        build/asm/psyq/de_12.o(.rodata);
        build/asm/gap_19A14.o(.rodata);
        build/asm/psyq/midicc.o(.rodata);
        build/asm/psyq/midimeta.o(.rodata);
        build/asm/psyq/midinote.o(.rodata);
        build/asm/gap_1A1D4.o(.rodata);
        build/asm/psyq/seqinit.o(.rodata);
        build/asm/gap_1A644.o(.rodata);
        build/asm/psyq/playmode.o(.rodata);
        build/asm/gap_1A9B4.o(.rodata);
        build/asm/psyq/ssstart.o(.rodata);
        build/asm/gap_1AEE4.o(.rodata);
        build/asm/psyq/cres.o(.rodata);
        build/asm/gap_1B364.o(.rodata);
        build/asm/psyq/midiread.o(.rodata);
        build/asm/gap_1BB24.o(.rodata);
        build/asm/psyq/sstick.o(.rodata);
        build/asm/gap_1C2E4.o(.rodata);
        build/asm/psyq/ssvol.o(.rodata);
        build/asm/psyq/tempo.o(.rodata);
        build/asm/gap_1C6D4.o(.rodata);
        build/asm/psyq/s_sva.o(.rodata);
        build/asm/psyq/s_n2p.o(.rodata);
        build/asm/psyq/ut_gpa.o(.rodata);
        build/asm/psyq/ut_gva.o(.rodata);
        build/asm/psyq/ut_key.o(.rodata);
        build/asm/psyq/ut_keyv.o(.rodata);
        build/asm/gap_1DC04.o(.rodata);
        build/asm/psyq/s_srmp.o(.rodata);
        build/asm/gap_1E124.o(.rodata);
        build/asm/psyq/ut_rev.o(.rodata);
        build/asm/gap_1E724.o(.rodata);
        build/asm/psyq/ut_sva.o(.rodata);
        build/asm/psyq/ut_vvol4.o(.rodata);
        build/asm/psyq/vm_aloc1.o(.rodata);
        build/asm/psyq/vm_aloc2.o(.rodata);
        build/asm/gap_1EF34.o(.rodata);
        build/asm/psyq/s_sav.o(.rodata);
        build/asm/gap_1F714.o(.rodata);
        build/asm/psyq/s_sk.o(.rodata);
        build/asm/gap_1F994.o(.rodata);
        build/asm/psyq/vm_init.o(.rodata);
        build/asm/psyq/s_m_init.o(.rodata);
        build/asm/gap_1FD64.o(.rodata);
        build/asm/psyq/vm_key.o(.rodata);
        build/asm/psyq/vm_n2p.o(.rodata);
        build/asm/psyq/vm_no1.o(.rodata);
        build/asm/gap_20C94.o(.rodata);
        build/asm/psyq/vm_nowof.o(.rodata);
        build/asm/psyq/vm_nowon.o(.rodata);
        build/asm/psyq/vm_pb.o(.rodata);
        build/asm/gap_21584.o(.rodata);
        build/asm/psyq/vm_seq.o(.rodata);
        build/asm/gap_21C74.o(.rodata);
        build/asm/psyq/vm_vol.o(.rodata);
        build/asm/psyq/vm_vsu.o(.rodata);
        build/asm/gap_223A4.o(.rodata);
        build/asm/psyq/vs_srv.o(.rodata);
        build/asm/gap_223F4.o(.rodata);
        build/asm/psyq/s_m_f.o(.rodata);
        build/asm/psyq/s_m_int.o(.rodata);
        build/asm/psyq/vs_vh2.o(.rodata);
        build/asm/psyq/s_m_m.o(.rodata);
        build/asm/psyq/vs_vh.o(.rodata);
        build/asm/psyq/vs_vtbp.o(.rodata);
        build/asm/psyq/s_stsa.o(.rodata);
        build/asm/psyq/s_stm.o(.rodata);
        build/asm/gap_23214.o(.rodata);
        build/asm/psyq/s_itc.o(.rodata);
        build/asm/psyq/vsync.o(.rodata);
        build/asm/psyq/intr.o(.rodata);
        build/asm/psyq/intr_vb.o(.rodata);
        build/asm/psyq/intr_dma.o(.rodata);
        build/asm/gap_24014.o(.rodata);
        build/asm/psyq/event.o(.rodata);
        build/asm/gap_24194.o(.rodata);
        build/asm/psyq/iso9660.o(.rodata);
        build/asm/psyq/bios_1.o(.rodata);
        build/asm/gap_26104.o(.rodata);
        build/asm/psyq/s_016.o(.rodata);
        build/asm/psyq/cdr_1.o(.rodata);
        build/asm/gap_26FC4.o(.rodata);
        build/asm/psyq/geo_00.o(.rodata);
        build/asm/psyq/geo_01.o(.rodata);
        build/asm/gap_27444.o(.rodata);
        build/asm/psyq/cor_02.o(.rodata);
        build/asm/psyq/cor_01.o(.rodata);
        build/asm/psyq/cor_03.o(.rodata);
        build/asm/psyq/cor_05.o(.rodata);
        build/asm/gap_27A74.o(.rodata);
        build/asm/psyq/msc02.o(.rodata);
        build/asm/gap_27E44.o(.rodata);
        build/asm/psyq/fgo_01.o(.rodata);
        build/asm/psyq/fgo_04.o(.rodata);
        build/asm/psyq/fgo_05.o(.rodata);
        build/asm/psyq/fgo_06.o(.rodata);
        build/asm/psyq/fgo_08.o(.rodata);
        build/asm/psyq/ratan.o(.rodata);
        build/asm/psyq/patchgte.o(.rodata);
        build/asm/gap_28E54.o(.rodata);
        build/asm/psyq/gs_001.o(.rodata);
        build/asm/psyq/gs_0022.o(.rodata);
        build/asm/gap_29554.o(.rodata);
        build/asm/psyq/gs_004.o(.rodata);
        build/asm/psyq/gs_103.o(.rodata);
        build/asm/gap_29764.o(.rodata);
        build/asm/psyq/gs_107.o(.rodata);
        build/asm/gap_29D74.o(.rodata);
        build/asm/psyq/gs_108.o(.rodata);
        build/asm/gap_29E24.o(.rodata);
        build/asm/psyq/kprintf.o(.rodata);
        build/asm/psyq/sys.o(.rodata);
        build/asm/psyq/e00.o(.rodata);
        build/asm/gap_2E854.o(.rodata);
        build/asm/psyq/e03.o(.rodata);
        build/asm/gap_2E984.o(.rodata);
        build/asm/psyq/p41.o(.rodata);
        build/asm/psyq/kt01.o(.rodata);
        build/asm/psyq/kt02.o(.rodata);
        build/asm/gap_2F2E4.o(.rodata);
        build/asm/psyq/libmcrd.o(.rodata);
        build/asm/gap_30FE4.o(.rodata);
        build/asm/psyq/userfunc.o(.rodata);
        build/asm/gap_31174.o(.rodata);
        build/asm/psyq/low.o(.rodata);
        build/asm/gap_322B4.o(.rodata);
        build/asm/psyq/unformat.o(.rodata);
        build/asm/gap_32374.o(.rodata);
        build/asm/psyq/sprintf.o(.rodata);
        build/asm/gap_32CE4.o(.rodata);
        build/asm/psyq/memmove.o(.rodata);
        build/asm/gap_32D64.o(.rodata);
        build/asm/psyq/counter.o(.rodata);
        build/asm/psyq/first.o(.rodata);
        build/asm/gap_33374.o(.rodata);
        build/asm/psyq/pad.o(.rodata);
        build/asm/gap_33614.o(.rodata);
        build/asm/psyq/mcxcmd1.o(.rodata);
        build/asm/psyq/mcxcmd2.o(.rodata);
        build/asm/gap_33A34.o(.rodata);
        build/asm/psyq/mcxcmd4.o(.rodata);
        build/asm/psyq/mcxcmd5.o(.rodata);
        build/asm/psyq/mcxcmd6.o(.rodata);
        build/asm/psyq/mcxcmd7.o(.rodata);
        build/asm/psyq/mcxcmd8.o(.rodata);
        build/asm/psyq/mcxcmd9.o(.rodata);
        build/asm/psyq/mcxcmd10.o(.rodata);
        build/asm/psyq/mcxcmd11.o(.rodata);
        build/asm/psyq/mcxcmd12.o(.rodata);
        build/asm/psyq/mcxcmd16.o(.rodata);
        build/asm/gap_34854.o(.rodata);
        build/asm/psyq/mcxcmd18.o(.rodata);
        build/asm/psyq/mcxcmd19.o(.rodata);
        build/asm/psyq/mcxcmd20.o(.rodata);
        build/asm/psyq/mcxcmd21.o(.rodata);
        build/asm/psyq/mcxcmd22.o(.rodata);
        build/asm/psyq/mcxcmd23.o(.rodata);
        build/asm/psyq/mcxcmd24.o(.rodata);
        build/asm/psyq/mcxcmd25.o(.rodata);
        build/asm/psyq/mcxcmd27.o(.rodata);
        build/asm/psyq/mcxresi.o(.rodata);
        build/asm/psyq/mcxinit.o(.rodata);
        build/asm/psyq/mcxmain.o(.rodata);
        build/asm/psyq/mcxdsr.o(.rodata);
        build/asm/gap_36514.o(.rodata);
        build/asm/psyq/pdcmd2.o(.rodata);
        build/asm/psyq/pdent2.o(.rodata);
        build/asm/psyq/pdent3.o(.rodata);
        build/asm/gap_368A4.o(.rodata);
        build/asm/psyq/pddirres.o(.rodata);
        build/asm/gap_374A4.o(.rodata);
        main_RODATA_END = .;
        main_RODATA_SIZE = ABSOLUTE(main_RODATA_END - main_RODATA_START);
        main_TEXT_START = .;
        build/src/crt0.o(.text);
        build/asm/stup0.o(.text);
        build/src/boot.o(.text);
        build/src/display.o(.text);
        build/src/system.o(.text);
        build/src/archive.o(.text);
        build/src/text.o(.text);
        build/src/flags.o(.text);
        build/src/state_core.o(.text);
        build/src/gameplay.o(.text);
        build/src/ui.o(.text);
        build/asm/psyq/adddf3.o(.text);
        build/asm/gap_15664.o(.text);
        build/asm/psyq/dbshift.o(.text);
        build/asm/psyq/fixdfsi.o(.text);
        build/asm/psyq/fltsidf.o(.text);
        build/asm/psyq/dbshiftu.o(.text);
        build/asm/psyq/ltdf2.o(.text);
        build/asm/gap_15B94.o(.text);
        build/asm/psyq/muldf3.o(.text);
        build/asm/psyq/ferr.o(.text);
        build/asm/psyq/sin00.o(.text);
        build/asm/psyq/divdf3.o(.text);
        build/asm/psyq/gedf2.o(.text);
        build/asm/gap_167E4.o(.text);
        build/asm/psyq/subdf3.o(.text);
        build/asm/psyq/sin01.o(.text);
        build/asm/psyq/s_gks.o(.text);
        build/asm/psyq/spu.o(.text);
        build/asm/gap_17544.o(.text);
        build/asm/psyq/sr_gaks.o(.text);
        build/asm/psyq/s_sca.o(.text);
        build/asm/psyq/ssclose.o(.text);
        build/asm/psyq/ssend.o(.text);
        build/asm/gap_17E34.o(.text);
        build/asm/psyq/s_crwa.o(.text);
        build/asm/psyq/s_m_util.o(.text);
        build/asm/psyq/ssopenq.o(.text);
        build/asm/gap_18474.o(.text);
        build/asm/psyq/cc_6.o(.text);
        build/asm/gap_18874.o(.text);
        build/asm/psyq/cc_64.o(.text);
        build/asm/gap_18BB4.o(.text);
        build/asm/psyq/cc_99.o(.text);
        build/asm/gap_18E84.o(.text);
        build/asm/psyq/de_1.o(.text);
        build/asm/gap_19174.o(.text);
        build/asm/psyq/de_12.o(.text);
        build/asm/gap_19A14.o(.text);
        build/asm/psyq/midicc.o(.text);
        build/asm/psyq/midimeta.o(.text);
        build/asm/psyq/midinote.o(.text);
        build/asm/gap_1A1D4.o(.text);
        build/asm/psyq/seqinit.o(.text);
        build/asm/gap_1A644.o(.text);
        build/asm/psyq/playmode.o(.text);
        build/asm/gap_1A9B4.o(.text);
        build/asm/psyq/ssstart.o(.text);
        build/asm/gap_1AEE4.o(.text);
        build/asm/psyq/cres.o(.text);
        build/asm/gap_1B364.o(.text);
        build/asm/psyq/midiread.o(.text);
        build/asm/gap_1BB24.o(.text);
        build/asm/psyq/sstick.o(.text);
        build/asm/gap_1C2E4.o(.text);
        build/asm/psyq/ssvol.o(.text);
        build/asm/psyq/tempo.o(.text);
        build/asm/gap_1C6D4.o(.text);
        build/asm/psyq/s_sva.o(.text);
        build/asm/psyq/s_n2p.o(.text);
        build/asm/psyq/ut_gpa.o(.text);
        build/asm/psyq/ut_gva.o(.text);
        build/asm/psyq/ut_key.o(.text);
        build/asm/psyq/ut_keyv.o(.text);
        build/asm/gap_1DC04.o(.text);
        build/asm/psyq/s_srmp.o(.text);
        build/asm/gap_1E124.o(.text);
        build/asm/psyq/ut_rev.o(.text);
        build/asm/gap_1E724.o(.text);
        build/asm/psyq/ut_sva.o(.text);
        build/asm/psyq/ut_vvol4.o(.text);
        build/asm/psyq/vm_aloc1.o(.text);
        build/asm/psyq/vm_aloc2.o(.text);
        build/asm/gap_1EF34.o(.text);
        build/asm/psyq/s_sav.o(.text);
        build/asm/gap_1F714.o(.text);
        build/asm/psyq/s_sk.o(.text);
        build/asm/gap_1F994.o(.text);
        build/asm/psyq/vm_init.o(.text);
        build/asm/psyq/s_m_init.o(.text);
        build/asm/gap_1FD64.o(.text);
        build/asm/psyq/vm_key.o(.text);
        build/asm/psyq/vm_n2p.o(.text);
        build/asm/psyq/vm_no1.o(.text);
        build/asm/gap_20C94.o(.text);
        build/asm/psyq/vm_nowof.o(.text);
        build/asm/psyq/vm_nowon.o(.text);
        build/asm/psyq/vm_pb.o(.text);
        build/asm/gap_21584.o(.text);
        build/asm/psyq/vm_seq.o(.text);
        build/asm/gap_21C74.o(.text);
        build/asm/psyq/vm_vol.o(.text);
        build/asm/psyq/vm_vsu.o(.text);
        build/asm/gap_223A4.o(.text);
        build/asm/psyq/vs_srv.o(.text);
        build/asm/gap_223F4.o(.text);
        build/asm/psyq/s_m_f.o(.text);
        build/asm/psyq/s_m_int.o(.text);
        build/asm/psyq/vs_vh2.o(.text);
        build/asm/psyq/s_m_m.o(.text);
        build/asm/psyq/vs_vh.o(.text);
        build/asm/psyq/vs_vtbp.o(.text);
        build/asm/psyq/s_stsa.o(.text);
        build/asm/psyq/s_stm.o(.text);
        build/asm/gap_23214.o(.text);
        build/asm/psyq/s_itc.o(.text);
        build/asm/psyq/vsync.o(.text);
        build/asm/psyq/intr.o(.text);
        build/asm/psyq/intr_vb.o(.text);
        build/asm/psyq/intr_dma.o(.text);
        build/asm/gap_24014.o(.text);
        build/asm/psyq/event.o(.text);
        build/asm/gap_24194.o(.text);
        build/asm/psyq/iso9660.o(.text);
        build/asm/psyq/bios_1.o(.text);
        build/asm/gap_26104.o(.text);
        build/asm/psyq/s_016.o(.text);
        build/asm/psyq/cdr_1.o(.text);
        build/asm/gap_26FC4.o(.text);
        build/asm/psyq/geo_00.o(.text);
        build/asm/psyq/geo_01.o(.text);
        build/asm/gap_27444.o(.text);
        build/asm/psyq/cor_02.o(.text);
        build/asm/psyq/cor_01.o(.text);
        build/asm/psyq/cor_03.o(.text);
        build/asm/psyq/cor_05.o(.text);
        build/asm/gap_27A74.o(.text);
        build/asm/psyq/msc02.o(.text);
        build/asm/gap_27E44.o(.text);
        build/asm/psyq/fgo_01.o(.text);
        build/asm/psyq/fgo_04.o(.text);
        build/asm/psyq/fgo_05.o(.text);
        build/asm/psyq/fgo_06.o(.text);
        build/asm/psyq/fgo_08.o(.text);
        build/asm/psyq/ratan.o(.text);
        build/asm/psyq/patchgte.o(.text);
        build/asm/gap_28E54.o(.text);
        build/asm/psyq/gs_001.o(.text);
        build/asm/psyq/gs_0022.o(.text);
        build/asm/gap_29554.o(.text);
        build/asm/psyq/gs_004.o(.text);
        build/asm/psyq/gs_103.o(.text);
        build/asm/gap_29764.o(.text);
        build/asm/psyq/gs_107.o(.text);
        build/asm/gap_29D74.o(.text);
        build/asm/psyq/gs_108.o(.text);
        build/asm/gap_29E24.o(.text);
        build/asm/psyq/kprintf.o(.text);
        build/asm/psyq/sys.o(.text);
        build/asm/psyq/e00.o(.text);
        build/asm/gap_2E854.o(.text);
        build/asm/psyq/e03.o(.text);
        build/asm/gap_2E984.o(.text);
        build/asm/psyq/p41.o(.text);
        build/asm/psyq/kt01.o(.text);
        build/asm/psyq/kt02.o(.text);
        build/asm/gap_2F2E4.o(.text);
        build/asm/psyq/libmcrd.o(.text);
        build/asm/gap_30FE4.o(.text);
        build/asm/psyq/userfunc.o(.text);
        build/asm/gap_31174.o(.text);
        build/asm/psyq/low.o(.text);
        build/asm/gap_322B4.o(.text);
        build/asm/psyq/unformat.o(.text);
        build/asm/gap_32374.o(.text);
        build/asm/psyq/sprintf.o(.text);
        build/asm/gap_32CE4.o(.text);
        build/asm/psyq/memmove.o(.text);
        build/asm/gap_32D64.o(.text);
        build/asm/psyq/counter.o(.text);
        build/asm/psyq/first.o(.text);
        build/asm/gap_33374.o(.text);
        build/asm/psyq/pad.o(.text);
        build/asm/gap_33614.o(.text);
        build/asm/psyq/mcxcmd1.o(.text);
        build/asm/psyq/mcxcmd2.o(.text);
        build/asm/gap_33A34.o(.text);
        build/asm/psyq/mcxcmd4.o(.text);
        build/asm/psyq/mcxcmd5.o(.text);
        build/asm/psyq/mcxcmd6.o(.text);
        build/asm/psyq/mcxcmd7.o(.text);
        build/asm/psyq/mcxcmd8.o(.text);
        build/asm/psyq/mcxcmd9.o(.text);
        build/asm/psyq/mcxcmd10.o(.text);
        build/asm/psyq/mcxcmd11.o(.text);
        build/asm/psyq/mcxcmd12.o(.text);
        build/asm/psyq/mcxcmd16.o(.text);
        build/asm/gap_34854.o(.text);
        build/asm/psyq/mcxcmd18.o(.text);
        build/asm/psyq/mcxcmd19.o(.text);
        build/asm/psyq/mcxcmd20.o(.text);
        build/asm/psyq/mcxcmd21.o(.text);
        build/asm/psyq/mcxcmd22.o(.text);
        build/asm/psyq/mcxcmd23.o(.text);
        build/asm/psyq/mcxcmd24.o(.text);
        build/asm/psyq/mcxcmd25.o(.text);
        build/asm/psyq/mcxcmd27.o(.text);
        build/asm/psyq/mcxresi.o(.text);
        build/asm/psyq/mcxinit.o(.text);
        build/asm/psyq/mcxmain.o(.text);
        build/asm/psyq/mcxdsr.o(.text);
        build/asm/gap_36514.o(.text);
        build/asm/psyq/pdcmd2.o(.text);
        build/asm/psyq/pdent2.o(.text);
        build/asm/psyq/pdent3.o(.text);
        build/asm/gap_368A4.o(.text);
        build/asm/psyq/pddirres.o(.text);
        build/asm/gap_374A4.o(.text);
        main_TEXT_END = .;
        main_TEXT_SIZE = ABSOLUTE(main_TEXT_END - main_TEXT_START);
        main_DATA_START = .;
        build/asm/data/800.rodata.o(.data);
        build/src/boot.o(.data);
        build/src/system.o(.data);
        build/asm/data/878.rodata.o(.data);
        build/src/text.o(.data);
        build/asm/data/A1C.rodata.o(.data);
        build/src/ui.o(.data);
        build/asm/data/BB0.rodata.o(.data);
        build/src/crt0.o(.data);
        build/asm/stup0.o(.data);
        build/src/display.o(.data);
        build/src/archive.o(.data);
        build/src/flags.o(.data);
        build/src/state_core.o(.data);
        build/src/gameplay.o(.data);
        build/asm/psyq/adddf3.o(.data);
        build/asm/gap_15664.o(.data);
        build/asm/psyq/dbshift.o(.data);
        build/asm/psyq/fixdfsi.o(.data);
        build/asm/psyq/fltsidf.o(.data);
        build/asm/psyq/dbshiftu.o(.data);
        build/asm/psyq/ltdf2.o(.data);
        build/asm/gap_15B94.o(.data);
        build/asm/psyq/muldf3.o(.data);
        build/asm/psyq/ferr.o(.data);
        build/asm/psyq/sin00.o(.data);
        build/asm/psyq/divdf3.o(.data);
        build/asm/psyq/gedf2.o(.data);
        build/asm/gap_167E4.o(.data);
        build/asm/psyq/subdf3.o(.data);
        build/asm/psyq/sin01.o(.data);
        build/asm/psyq/s_gks.o(.data);
        build/asm/psyq/spu.o(.data);
        build/asm/gap_17544.o(.data);
        build/asm/psyq/sr_gaks.o(.data);
        build/asm/psyq/s_sca.o(.data);
        build/asm/psyq/ssclose.o(.data);
        build/asm/psyq/ssend.o(.data);
        build/asm/gap_17E34.o(.data);
        build/asm/psyq/s_crwa.o(.data);
        build/asm/psyq/s_m_util.o(.data);
        build/asm/psyq/ssopenq.o(.data);
        build/asm/gap_18474.o(.data);
        build/asm/psyq/cc_6.o(.data);
        build/asm/gap_18874.o(.data);
        build/asm/psyq/cc_64.o(.data);
        build/asm/gap_18BB4.o(.data);
        build/asm/psyq/cc_99.o(.data);
        build/asm/gap_18E84.o(.data);
        build/asm/psyq/de_1.o(.data);
        build/asm/gap_19174.o(.data);
        build/asm/psyq/de_12.o(.data);
        build/asm/gap_19A14.o(.data);
        build/asm/psyq/midicc.o(.data);
        build/asm/psyq/midimeta.o(.data);
        build/asm/psyq/midinote.o(.data);
        build/asm/gap_1A1D4.o(.data);
        build/asm/psyq/seqinit.o(.data);
        build/asm/gap_1A644.o(.data);
        build/asm/psyq/playmode.o(.data);
        build/asm/gap_1A9B4.o(.data);
        build/asm/psyq/ssstart.o(.data);
        build/asm/gap_1AEE4.o(.data);
        build/asm/psyq/cres.o(.data);
        build/asm/gap_1B364.o(.data);
        build/asm/psyq/midiread.o(.data);
        build/asm/gap_1BB24.o(.data);
        build/asm/psyq/sstick.o(.data);
        build/asm/gap_1C2E4.o(.data);
        build/asm/psyq/ssvol.o(.data);
        build/asm/psyq/tempo.o(.data);
        build/asm/gap_1C6D4.o(.data);
        build/asm/psyq/s_sva.o(.data);
        build/asm/psyq/s_n2p.o(.data);
        build/asm/psyq/ut_gpa.o(.data);
        build/asm/psyq/ut_gva.o(.data);
        build/asm/psyq/ut_key.o(.data);
        build/asm/psyq/ut_keyv.o(.data);
        build/asm/gap_1DC04.o(.data);
        build/asm/psyq/s_srmp.o(.data);
        build/asm/gap_1E124.o(.data);
        build/asm/psyq/ut_rev.o(.data);
        build/asm/gap_1E724.o(.data);
        build/asm/psyq/ut_sva.o(.data);
        build/asm/psyq/ut_vvol4.o(.data);
        build/asm/psyq/vm_aloc1.o(.data);
        build/asm/psyq/vm_aloc2.o(.data);
        build/asm/gap_1EF34.o(.data);
        build/asm/psyq/s_sav.o(.data);
        build/asm/gap_1F714.o(.data);
        build/asm/psyq/s_sk.o(.data);
        build/asm/gap_1F994.o(.data);
        build/asm/psyq/vm_init.o(.data);
        build/asm/psyq/s_m_init.o(.data);
        build/asm/gap_1FD64.o(.data);
        build/asm/psyq/vm_key.o(.data);
        build/asm/psyq/vm_n2p.o(.data);
        build/asm/psyq/vm_no1.o(.data);
        build/asm/gap_20C94.o(.data);
        build/asm/psyq/vm_nowof.o(.data);
        build/asm/psyq/vm_nowon.o(.data);
        build/asm/psyq/vm_pb.o(.data);
        build/asm/gap_21584.o(.data);
        build/asm/psyq/vm_seq.o(.data);
        build/asm/gap_21C74.o(.data);
        build/asm/psyq/vm_vol.o(.data);
        build/asm/psyq/vm_vsu.o(.data);
        build/asm/gap_223A4.o(.data);
        build/asm/psyq/vs_srv.o(.data);
        build/asm/gap_223F4.o(.data);
        build/asm/psyq/s_m_f.o(.data);
        build/asm/psyq/s_m_int.o(.data);
        build/asm/psyq/vs_vh2.o(.data);
        build/asm/psyq/s_m_m.o(.data);
        build/asm/psyq/vs_vh.o(.data);
        build/asm/psyq/vs_vtbp.o(.data);
        build/asm/psyq/s_stsa.o(.data);
        build/asm/psyq/s_stm.o(.data);
        build/asm/gap_23214.o(.data);
        build/asm/psyq/s_itc.o(.data);
        build/asm/psyq/vsync.o(.data);
        build/asm/psyq/intr.o(.data);
        build/asm/psyq/intr_vb.o(.data);
        build/asm/psyq/intr_dma.o(.data);
        build/asm/gap_24014.o(.data);
        build/asm/psyq/event.o(.data);
        build/asm/gap_24194.o(.data);
        build/asm/psyq/iso9660.o(.data);
        build/asm/psyq/bios_1.o(.data);
        build/asm/gap_26104.o(.data);
        build/asm/psyq/s_016.o(.data);
        build/asm/psyq/cdr_1.o(.data);
        build/asm/gap_26FC4.o(.data);
        build/asm/psyq/geo_00.o(.data);
        build/asm/psyq/geo_01.o(.data);
        build/asm/gap_27444.o(.data);
        build/asm/psyq/cor_02.o(.data);
        build/asm/psyq/cor_01.o(.data);
        build/asm/psyq/cor_03.o(.data);
        build/asm/psyq/cor_05.o(.data);
        build/asm/gap_27A74.o(.data);
        build/asm/psyq/msc02.o(.data);
        build/asm/gap_27E44.o(.data);
        build/asm/psyq/fgo_01.o(.data);
        build/asm/psyq/fgo_04.o(.data);
        build/asm/psyq/fgo_05.o(.data);
        build/asm/psyq/fgo_06.o(.data);
        build/asm/psyq/fgo_08.o(.data);
        build/asm/psyq/ratan.o(.data);
        build/asm/psyq/patchgte.o(.data);
        build/asm/gap_28E54.o(.data);
        build/asm/psyq/gs_001.o(.data);
        build/asm/psyq/gs_0022.o(.data);
        build/asm/gap_29554.o(.data);
        build/asm/psyq/gs_004.o(.data);
        build/asm/psyq/gs_103.o(.data);
        build/asm/gap_29764.o(.data);
        build/asm/psyq/gs_107.o(.data);
        build/asm/gap_29D74.o(.data);
        build/asm/psyq/gs_108.o(.data);
        build/asm/gap_29E24.o(.data);
        build/asm/psyq/kprintf.o(.data);
        build/asm/psyq/sys.o(.data);
        build/asm/psyq/e00.o(.data);
        build/asm/gap_2E854.o(.data);
        build/asm/psyq/e03.o(.data);
        build/asm/gap_2E984.o(.data);
        build/asm/psyq/p41.o(.data);
        build/asm/psyq/kt01.o(.data);
        build/asm/psyq/kt02.o(.data);
        build/asm/gap_2F2E4.o(.data);
        build/asm/psyq/libmcrd.o(.data);
        build/asm/gap_30FE4.o(.data);
        build/asm/psyq/userfunc.o(.data);
        build/asm/gap_31174.o(.data);
        build/asm/psyq/low.o(.data);
        build/asm/gap_322B4.o(.data);
        build/asm/psyq/unformat.o(.data);
        build/asm/gap_32374.o(.data);
        build/asm/psyq/sprintf.o(.data);
        build/asm/gap_32CE4.o(.data);
        build/asm/psyq/memmove.o(.data);
        build/asm/gap_32D64.o(.data);
        build/asm/psyq/counter.o(.data);
        build/asm/psyq/first.o(.data);
        build/asm/gap_33374.o(.data);
        build/asm/psyq/pad.o(.data);
        build/asm/gap_33614.o(.data);
        build/asm/psyq/mcxcmd1.o(.data);
        build/asm/psyq/mcxcmd2.o(.data);
        build/asm/gap_33A34.o(.data);
        build/asm/psyq/mcxcmd4.o(.data);
        build/asm/psyq/mcxcmd5.o(.data);
        build/asm/psyq/mcxcmd6.o(.data);
        build/asm/psyq/mcxcmd7.o(.data);
        build/asm/psyq/mcxcmd8.o(.data);
        build/asm/psyq/mcxcmd9.o(.data);
        build/asm/psyq/mcxcmd10.o(.data);
        build/asm/psyq/mcxcmd11.o(.data);
        build/asm/psyq/mcxcmd12.o(.data);
        build/asm/psyq/mcxcmd16.o(.data);
        build/asm/gap_34854.o(.data);
        build/asm/psyq/mcxcmd18.o(.data);
        build/asm/psyq/mcxcmd19.o(.data);
        build/asm/psyq/mcxcmd20.o(.data);
        build/asm/psyq/mcxcmd21.o(.data);
        build/asm/psyq/mcxcmd22.o(.data);
        build/asm/psyq/mcxcmd23.o(.data);
        build/asm/psyq/mcxcmd24.o(.data);
        build/asm/psyq/mcxcmd25.o(.data);
        build/asm/psyq/mcxcmd27.o(.data);
        build/asm/psyq/mcxresi.o(.data);
        build/asm/psyq/mcxinit.o(.data);
        build/asm/psyq/mcxmain.o(.data);
        build/asm/psyq/mcxdsr.o(.data);
        build/asm/gap_36514.o(.data);
        build/asm/psyq/pdcmd2.o(.data);
        build/asm/psyq/pdent2.o(.data);
        build/asm/psyq/pdent3.o(.data);
        build/asm/gap_368A4.o(.data);
        build/asm/psyq/pddirres.o(.data);
        build/asm/gap_374A4.o(.data);
        build/asm/data/39314.data.o(.data);
        main_DATA_END = .;
        main_DATA_SIZE = ABSOLUTE(main_DATA_END - main_DATA_START);
        main_BSS_START = .;
        build/asm/data/800.rodata.o(.bss);
        build/src/boot.o(.bss);
        build/src/system.o(.bss);
        build/asm/data/878.rodata.o(.bss);
        build/src/text.o(.bss);
        build/asm/data/A1C.rodata.o(.bss);
        build/src/ui.o(.bss);
        build/asm/data/BB0.rodata.o(.bss);
        build/src/crt0.o(.bss);
        build/asm/stup0.o(.bss);
        build/src/display.o(.bss);
        build/src/archive.o(.bss);
        build/src/flags.o(.bss);
        build/src/state_core.o(.bss);
        build/src/gameplay.o(.bss);
        build/asm/psyq/adddf3.o(.bss);
        build/asm/gap_15664.o(.bss);
        build/asm/psyq/dbshift.o(.bss);
        build/asm/psyq/fixdfsi.o(.bss);
        build/asm/psyq/fltsidf.o(.bss);
        build/asm/psyq/dbshiftu.o(.bss);
        build/asm/psyq/ltdf2.o(.bss);
        build/asm/gap_15B94.o(.bss);
        build/asm/psyq/muldf3.o(.bss);
        build/asm/psyq/ferr.o(.bss);
        build/asm/psyq/sin00.o(.bss);
        build/asm/psyq/divdf3.o(.bss);
        build/asm/psyq/gedf2.o(.bss);
        build/asm/gap_167E4.o(.bss);
        build/asm/psyq/subdf3.o(.bss);
        build/asm/psyq/sin01.o(.bss);
        build/asm/psyq/s_gks.o(.bss);
        build/asm/psyq/spu.o(.bss);
        build/asm/gap_17544.o(.bss);
        build/asm/psyq/sr_gaks.o(.bss);
        build/asm/psyq/s_sca.o(.bss);
        build/asm/psyq/ssclose.o(.bss);
        build/asm/psyq/ssend.o(.bss);
        build/asm/gap_17E34.o(.bss);
        build/asm/psyq/s_crwa.o(.bss);
        build/asm/psyq/s_m_util.o(.bss);
        build/asm/psyq/ssopenq.o(.bss);
        build/asm/gap_18474.o(.bss);
        build/asm/psyq/cc_6.o(.bss);
        build/asm/gap_18874.o(.bss);
        build/asm/psyq/cc_64.o(.bss);
        build/asm/gap_18BB4.o(.bss);
        build/asm/psyq/cc_99.o(.bss);
        build/asm/gap_18E84.o(.bss);
        build/asm/psyq/de_1.o(.bss);
        build/asm/gap_19174.o(.bss);
        build/asm/psyq/de_12.o(.bss);
        build/asm/gap_19A14.o(.bss);
        build/asm/psyq/midicc.o(.bss);
        build/asm/psyq/midimeta.o(.bss);
        build/asm/psyq/midinote.o(.bss);
        build/asm/gap_1A1D4.o(.bss);
        build/asm/psyq/seqinit.o(.bss);
        build/asm/gap_1A644.o(.bss);
        build/asm/psyq/playmode.o(.bss);
        build/asm/gap_1A9B4.o(.bss);
        build/asm/psyq/ssstart.o(.bss);
        build/asm/gap_1AEE4.o(.bss);
        build/asm/psyq/cres.o(.bss);
        build/asm/gap_1B364.o(.bss);
        build/asm/psyq/midiread.o(.bss);
        build/asm/gap_1BB24.o(.bss);
        build/asm/psyq/sstick.o(.bss);
        build/asm/gap_1C2E4.o(.bss);
        build/asm/psyq/ssvol.o(.bss);
        build/asm/psyq/tempo.o(.bss);
        build/asm/gap_1C6D4.o(.bss);
        build/asm/psyq/s_sva.o(.bss);
        build/asm/psyq/s_n2p.o(.bss);
        build/asm/psyq/ut_gpa.o(.bss);
        build/asm/psyq/ut_gva.o(.bss);
        build/asm/psyq/ut_key.o(.bss);
        build/asm/psyq/ut_keyv.o(.bss);
        build/asm/gap_1DC04.o(.bss);
        build/asm/psyq/s_srmp.o(.bss);
        build/asm/gap_1E124.o(.bss);
        build/asm/psyq/ut_rev.o(.bss);
        build/asm/gap_1E724.o(.bss);
        build/asm/psyq/ut_sva.o(.bss);
        build/asm/psyq/ut_vvol4.o(.bss);
        build/asm/psyq/vm_aloc1.o(.bss);
        build/asm/psyq/vm_aloc2.o(.bss);
        build/asm/gap_1EF34.o(.bss);
        build/asm/psyq/s_sav.o(.bss);
        build/asm/gap_1F714.o(.bss);
        build/asm/psyq/s_sk.o(.bss);
        build/asm/gap_1F994.o(.bss);
        build/asm/psyq/vm_init.o(.bss);
        build/asm/psyq/s_m_init.o(.bss);
        build/asm/gap_1FD64.o(.bss);
        build/asm/psyq/vm_key.o(.bss);
        build/asm/psyq/vm_n2p.o(.bss);
        build/asm/psyq/vm_no1.o(.bss);
        build/asm/gap_20C94.o(.bss);
        build/asm/psyq/vm_nowof.o(.bss);
        build/asm/psyq/vm_nowon.o(.bss);
        build/asm/psyq/vm_pb.o(.bss);
        build/asm/gap_21584.o(.bss);
        build/asm/psyq/vm_seq.o(.bss);
        build/asm/gap_21C74.o(.bss);
        build/asm/psyq/vm_vol.o(.bss);
        build/asm/psyq/vm_vsu.o(.bss);
        build/asm/gap_223A4.o(.bss);
        build/asm/psyq/vs_srv.o(.bss);
        build/asm/gap_223F4.o(.bss);
        build/asm/psyq/s_m_f.o(.bss);
        build/asm/psyq/s_m_int.o(.bss);
        build/asm/psyq/vs_vh2.o(.bss);
        build/asm/psyq/s_m_m.o(.bss);
        build/asm/psyq/vs_vh.o(.bss);
        build/asm/psyq/vs_vtbp.o(.bss);
        build/asm/psyq/s_stsa.o(.bss);
        build/asm/psyq/s_stm.o(.bss);
        build/asm/gap_23214.o(.bss);
        build/asm/psyq/s_itc.o(.bss);
        build/asm/psyq/vsync.o(.bss);
        build/asm/psyq/intr.o(.bss);
        build/asm/psyq/intr_vb.o(.bss);
        build/asm/psyq/intr_dma.o(.bss);
        build/asm/gap_24014.o(.bss);
        build/asm/psyq/event.o(.bss);
        build/asm/gap_24194.o(.bss);
        build/asm/psyq/iso9660.o(.bss);
        build/asm/psyq/bios_1.o(.bss);
        build/asm/gap_26104.o(.bss);
        build/asm/psyq/s_016.o(.bss);
        build/asm/psyq/cdr_1.o(.bss);
        build/asm/gap_26FC4.o(.bss);
        build/asm/psyq/geo_00.o(.bss);
        build/asm/psyq/geo_01.o(.bss);
        build/asm/gap_27444.o(.bss);
        build/asm/psyq/cor_02.o(.bss);
        build/asm/psyq/cor_01.o(.bss);
        build/asm/psyq/cor_03.o(.bss);
        build/asm/psyq/cor_05.o(.bss);
        build/asm/gap_27A74.o(.bss);
        build/asm/psyq/msc02.o(.bss);
        build/asm/gap_27E44.o(.bss);
        build/asm/psyq/fgo_01.o(.bss);
        build/asm/psyq/fgo_04.o(.bss);
        build/asm/psyq/fgo_05.o(.bss);
        build/asm/psyq/fgo_06.o(.bss);
        build/asm/psyq/fgo_08.o(.bss);
        build/asm/psyq/ratan.o(.bss);
        build/asm/psyq/patchgte.o(.bss);
        build/asm/gap_28E54.o(.bss);
        build/asm/psyq/gs_001.o(.bss);
        build/asm/psyq/gs_0022.o(.bss);
        build/asm/gap_29554.o(.bss);
        build/asm/psyq/gs_004.o(.bss);
        build/asm/psyq/gs_103.o(.bss);
        build/asm/gap_29764.o(.bss);
        build/asm/psyq/gs_107.o(.bss);
        build/asm/gap_29D74.o(.bss);
        build/asm/psyq/gs_108.o(.bss);
        build/asm/gap_29E24.o(.bss);
        build/asm/psyq/kprintf.o(.bss);
        build/asm/psyq/sys.o(.bss);
        build/asm/psyq/e00.o(.bss);
        build/asm/gap_2E854.o(.bss);
        build/asm/psyq/e03.o(.bss);
        build/asm/gap_2E984.o(.bss);
        build/asm/psyq/p41.o(.bss);
        build/asm/psyq/kt01.o(.bss);
        build/asm/psyq/kt02.o(.bss);
        build/asm/gap_2F2E4.o(.bss);
        build/asm/psyq/libmcrd.o(.bss);
        build/asm/gap_30FE4.o(.bss);
        build/asm/psyq/userfunc.o(.bss);
        build/asm/gap_31174.o(.bss);
        build/asm/psyq/low.o(.bss);
        build/asm/gap_322B4.o(.bss);
        build/asm/psyq/unformat.o(.bss);
        build/asm/gap_32374.o(.bss);
        build/asm/psyq/sprintf.o(.bss);
        build/asm/gap_32CE4.o(.bss);
        build/asm/psyq/memmove.o(.bss);
        build/asm/gap_32D64.o(.bss);
        build/asm/psyq/counter.o(.bss);
        build/asm/psyq/first.o(.bss);
        build/asm/gap_33374.o(.bss);
        build/asm/psyq/pad.o(.bss);
        build/asm/gap_33614.o(.bss);
        build/asm/psyq/mcxcmd1.o(.bss);
        build/asm/psyq/mcxcmd2.o(.bss);
        build/asm/gap_33A34.o(.bss);
        build/asm/psyq/mcxcmd4.o(.bss);
        build/asm/psyq/mcxcmd5.o(.bss);
        build/asm/psyq/mcxcmd6.o(.bss);
        build/asm/psyq/mcxcmd7.o(.bss);
        build/asm/psyq/mcxcmd8.o(.bss);
        build/asm/psyq/mcxcmd9.o(.bss);
        build/asm/psyq/mcxcmd10.o(.bss);
        build/asm/psyq/mcxcmd11.o(.bss);
        build/asm/psyq/mcxcmd12.o(.bss);
        build/asm/psyq/mcxcmd16.o(.bss);
        build/asm/gap_34854.o(.bss);
        build/asm/psyq/mcxcmd18.o(.bss);
        build/asm/psyq/mcxcmd19.o(.bss);
        build/asm/psyq/mcxcmd20.o(.bss);
        build/asm/psyq/mcxcmd21.o(.bss);
        build/asm/psyq/mcxcmd22.o(.bss);
        build/asm/psyq/mcxcmd23.o(.bss);
        build/asm/psyq/mcxcmd24.o(.bss);
        build/asm/psyq/mcxcmd25.o(.bss);
        build/asm/psyq/mcxcmd27.o(.bss);
        build/asm/psyq/mcxresi.o(.bss);
        build/asm/psyq/mcxinit.o(.bss);
        build/asm/psyq/mcxmain.o(.bss);
        build/asm/psyq/mcxdsr.o(.bss);
        build/asm/gap_36514.o(.bss);
        build/asm/psyq/pdcmd2.o(.bss);
        build/asm/psyq/pdent2.o(.bss);
        build/asm/psyq/pdent3.o(.bss);
        build/asm/gap_368A4.o(.bss);
        build/asm/psyq/pddirres.o(.bss);
        build/asm/gap_374A4.o(.bss);
        main_BSS_END = .;
        main_BSS_SIZE = ABSOLUTE(main_BSS_END - main_BSS_START);
    }
    __romPos += SIZEOF(.main);
    __romPos = ALIGN(__romPos, 16);
    main_ROM_END = __romPos;
    main_VRAM_END = .;

    /DISCARD/ :
    {
        *(*);
    }
}
